## buildroot/package/FLAC/Config.in
```kconfig
config BR2_PACKAGE_FLAC
	bool "libFLAC "
	default n
	help

	    http://flac.sourceforge.net/
```

## buildroot/package/alsa-lib/Config.in
```kconfig
config BR2_PACKAGE_ALSA_LIB
	bool "alsa-lib"
	default n
	help
	  The Advanced Linux Sound Architecture (ALSA) provides audio and MIDI
	  functionality to the Linux operating system.

	  http://www.alsa-project.org/

config BR2_PACKAGE_ALSA_LIB_NO_LIBRT
	bool
	default n
	help
	  Do not depend on librt for monotomic clock.
```

## buildroot/package/audiocompress/Config.in
```kconfig
config BR2_PACKAGE_AUDIOCOMPRESS
        bool "audiocompress"
        default n
        help
        Audio compressor library
```

## buildroot/package/domx/Config.in
```kconfig
config BR2_PACKAGE_DOMX
	bool "domx"
	default n
	help
		Build Ducati remote OpenMAX component
```

## buildroot/package/libav/Config.in
```kconfig
config BR2_PACKAGE_LIBAV
	bool "libav"
	depends on BR2_PACKAGE_ZLIB 
	default n
	help
	 libav
```

## buildroot/package/libexif/Config.in
```kconfig
config BR2_PACKAGE_LIBEXIF
	bool "libexif"
	default n
	help

	    http://libexif.sourceforge.net/
```

## buildroot/package/libogg/Config.in
```kconfig
config BR2_PACKAGE_FLAC
	bool "libogg"
	default n
	help

	    http://www.xiph.org/ogg/
```

## buildroot/package/libvorbis/Config.in
```kconfig
config BR2_PACKAGE_VORBIS
	bool "libvorbis"
	default n
	help

	    http://xiph.org/vorbis/
```

## buildroot/package/live555/Config.in
```kconfig
config BR2_PACKAGE_LIVE555
	bool "live555"
	default y
	help
	  http://www.live555.com
```

## buildroot/package/lsdvd/Config.in
```kconfig
config BR2_PACKAGE_LSDVD
	bool "lsdvd"
	depends on BR2_PACKAGE_LIBDVDREAD
	default n
	help
	 lsdvd
```

## buildroot/package/minidlna/Config.in
```kconfig
config BR2_PACKAGE_MINIDLNA
	bool "minidlna, a dlna server"
	default n
	help

	    http://sourceforge.net/projects/minidlna/
```

## buildroot/package/samba-3.3.3/Config.in
```kconfig
config BR2_PACKAGE_SAMBA_3_3_3
	bool "sambagplv3"
	default n
	help

	Installs the smbd and the nmbd from the samba package. WARNING: GPLv3
```

## buildroot/package/syslink/Config.in
```kconfig
config BR2_PACKAGE_SYSLINK
	bool "syslink"
	default n
	help
		Build syslink libs and daemon
```

## buildroot/package/syslink_d2c/Config.in
```kconfig
config BR2_PACKAGE_SYSLINK_D2C
	bool "syslink_d2c"
	default n
	help
		Build syslink/d2c builds
```

## buildroot/package/tiler/Config.in
```kconfig
config BR2_PACKAGE_TILER
	bool "tiler"
	default n
	help
		Build libtimemmgr used in some TI stuff
```

## buildroot/package/tinyalsa/Config.in
```kconfig
config BR2_PACKAGE_TINYALSA
	bool "tinyalsa"
	default n
	help
	  A small library to interface with ALSA in the Linux kernel

	  https://github.com/tinyalsa/tinyalsa
```

## buildroot/package/usb_modeswitch/Config.in
```kconfig
config BR2_PACKAGE_USB_MODESWITCH
	bool "usb_modeswitch"
	default n
	help
	  USB_ModeSwitch is (surprise!) a small mode switching tool for controlling
	  a"flip flop" (multiple mode) USB gear.

	  http://www.draisberghof.de/usb_modeswitch
```

## buildroot/package/wpa_supplicant/Config.in
```kconfig
config BR2_PACKAGE_WPA_SUPPLICANT
        bool "wpa_supplicant"
        default n
        help
        The wpa_supplicant is a wireless lan authentication/association daemon. 
        Beware you must have avx/wpa_supplicant checked out for this target to 
        actually work.
```

## buildroot/package/wpa_supplicant_tiwlan/Config.in
```kconfig
config BR2_PACKAGE_WPA_SUPPLICANT_TIWLAN
        bool "wpa_supplicant 0.5.x"
        default n
        help
        The wpa_supplicant 0.5.x is a wireless lan authentication/association daemon. 
        Beware you must have avx/wpa_supplicant checked out for this target to 
        actually work.
```
